## Kconfig
```kconfig
#
# For a description of the syntax of this configuration file,
# see Documentation/kbuild/kconfig-language.txt.
#
mainmenu "MYAPP Configuration"

#config SRCARCH
#	string
#	option env="SRCARCH"

#source "arch/$SRCARCH/Kconfig"


menu "Compile-time checks and compiler options"

config CROSS_COMPILE
	string "Cross-compiler tool prefix"
	help
	  Same as running 'make CROSS_COMPILE=prefix-' but stored for
	  default make runs in this application build directory.  You don't
	  need to set this unless you want the configured application build
	  directory to select the cross-compiler automatically.

choice
	prompt "Compiler optimization level"
	default CONFIG_CC_OPTIMIZE_FOR_PERFORMANCE

config CC_OPTIMIZE_FOR_PERFORMANCE
	bool "Optimize for performance"
	help
	  This is the default optimization level for the kernel, building
	  with the "-O2" compiler flag for best performance and most
	  helpful compile-time warnings.

config CC_OPTIMIZE_FOR_SIZE
	bool "Optimize for size"
	help
	  Enabling this option will pass "-Os" instead of "-O2" to
	  your compiler resulting in a smaller kernel.

	  If unsure, say N.

endchoice

config DEBUG_INFO
	bool "Compile the application with debug info"
	help
          If you say Y here the resulting application binary will include
	  debugging info resulting in a larger application binary.
	  This adds debug symbols to the application (gcc -g), and
	  is needed if you want to debug your application with gdb.
	  Say Y here only if you plan to debug the application.

	  If unsure, say N.

config DEBUG_INFO_REDUCED
	bool "Reduce debugging information"
	depends on DEBUG_INFO
	help
	  If you say Y here gcc is instructed to generate less debugging
	  information for structure types. This means that tools that
	  need full debugging information (like gdb or systemtap) won't
	  be happy. But if you merely need debugging information to
	  resolve line numbers there is no loss. Advantage is that
	  build directory object sizes shrink dramatically over a full
	  DEBUG_INFO build and compile times are reduced too.
	  Only works with newer gcc versions.

config DEBUG_INFO_SPLIT
	bool "Produce split debuginfo in .dwo files"
	depends on DEBUG_INFO
	help
	  Generate debug info into separate .dwo files. This significantly
	  reduces the build directory size for builds with DEBUG_INFO,
	  because it stores the information only once on disk in .dwo
	  files instead of multiple times in object files and executables.
	  In addition the debug information is also compressed.

	  Requires recent gcc (4.7+) and recent gdb/binutils.
	  Any tool that packages or reads debug information would need
	  to know about the .dwo files and include them.
	  Incompatible with older versions of ccache.

config DEBUG_INFO_DWARF4
	bool "Generate dwarf4 debuginfo"
	depends on DEBUG_INFO
	help
	  Generate dwarf4 debug info. This requires recent versions
	  of gcc and gdb. It makes the debug information larger.
	  But it significantly improves the success of resolving
	  variables in gdb on optimized code.


endmenu


source "main/Kconfig"

source "lib/Kconfig"
```

## lib/Kconfig
```kconfig
config LOG_ENABLE
	bool "Enable log output"
	default y
	help
	  Say Y if you want to enable log output.
	  If you say N here, those functions are not compiled.

config LOG_INFO
    bool "Enable info log messages"
    default n
    depends on LOG_ENABLE
	help
	  Say Y if you want to enable informational log message output.

config LOG_WARN
    bool "Enable warning log messages"
    default n
    depends on LOG_ENABLE
	help
	  Say Y if you want to enable warning log message output.

config LOG_ERROR
    bool "Enable error log messages"
    default y
    depends on LOG_ENABLE
	help
	  Say Y if you want to enable error log message output.

config LOG_DEBUG
    bool "Enable debug log messages"
    default n
    depends on LOG_ENABLE
	help
	  Say Y if you want to enable debug log message output.

config LOG_TIMESTAMP
	bool "Show a timestamp on log functions"
	default y
    depends on LOG_ENABLE
	help
	  Select this option to include a timestamp in the log output.
```

## main/Kconfig
```kconfig
config ENABLE_FOO_BAR
	bool "Enable Foo / Bar options"
	default y
	help
	  Say Y if you want to enable foo or foobar functionality.

config FOO
	bool "Foo"
    depends on ENABLE_FOO_BAR
	help
	  foo.

config BAR
	bool "Bar"
	depends on FOO
	help
	  bar.
```
